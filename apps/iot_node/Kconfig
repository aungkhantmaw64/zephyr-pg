## apps/iot_node/Kconfig
```kconfig
menu "IoT Node Configuration"

rsource "src/modules/environmental/Kconfig.environmental"

endmenu

menu "Zephyr Kernel"
source "Kconfig.zephyr"
endmenu
```

## apps/iot_node/src/modules/environmental/Kconfig.environmental
```kconfig
#
# Copyright (c) 2025 Aung Khant Maw
#

menuconfig IOT_NODE_MODULES_ENVIRONMENTAL
	bool "Environmental module"
	default y

if IOT_NODE_MODULES_ENVIRONMENTAL

module = IOT_NODE_MODULES_ENVIRONMENTAL
module-str = ENVIRONMENTAL
source "subsys/logging/Kconfig.template.log_config"

endif # ENVIRONMENTAL
```

## apps/thread_01/Kconfig
```kconfig
menu "Thread Demo 01"

rsource "src/modules/bar/Kconfig.bar"
rsource "src/modules/foo/Kconfig.foo"

endmenu

menu "Zephyr Kernel"
source "Kconfig.zephyr"
endmenu
```

## apps/thread_01/src/modules/bar/Kconfig.bar
```kconfig
#
# Copyright (c) 2025 Aung Khant Maw
#

menuconfig APP_BAR
	bool "Bar module"
	default y

if APP_BAR

module = APP_BAR
module-str = BAR
source "subsys/logging/Kconfig.template.log_config"

endif # APP_BAR
```

## apps/thread_01/src/modules/foo/Kconfig.foo
```kconfig
#
# Copyright (c) 2025 Aung Khant Maw
#

menuconfig APP_FOO
	bool "Foo module"
	default y

if APP_FOO

module = APP_FOO
module-str = FOO
source "subsys/logging/Kconfig.template.log_config"

endif # APP_BAR
```
